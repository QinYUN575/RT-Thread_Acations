## RT-Thread_RCEA/one_week/stm32f103-max_32/board/Kconfig
```kconfig
menu "Hardware Drivers Config"

config SOC_STM32F103ZE
    bool
    select SOC_SERIES_STM32F1
    default y

menu "Onboard Peripheral Drivers"

endmenu

menu "On-chip Peripheral Drivers"

    config BSP_USING_GPIO
        bool "Enable GPIO"
        select RT_USING_PIN
        default y

    menuconfig BSP_USING_UART
        bool "Enable UART"
        default y
        select RT_USING_SERIAL
        if BSP_USING_UART
            config BSP_USING_UART1
                bool "Enable UART1"
                default y
        endif

    menuconfig BSP_USING_PWM
        bool "Enable PWM"
        default n
        select RT_USING_PWM
        if BSP_USING_PWM
            menuconfig BSP_USING_PWM3
                bool "Enable timer3 output pwm"
                default n
                if BSP_USING_PWM3
                    config BSP_USING_PWM3_CH2
                        bool "Enable PWM3 CH2"
                        default n
                endif
        endif

endmenu

menu "Board extended module Drivers"

endmenu

endmenu
```
